// Setup
#include <MaxMatrix.h>
#include <avr/pgmspace.h>
PROGMEM const char CH[] = {

  3, 8, B00000000, B00000000, B00000000, B00000000, B00000000,  // space

  1, 8, B01011111, B00000000, B00000000, B00000000, B00000000,  // !
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  4, 8, B00001000, B00000100, B00001000, B00000100, B00000000,  // ~

};
char skullEmoji[] = {
  8,
  8,
  B00001110,
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  B00001110,
};  //💀
int data = 12;
int load = 10;
int clock = 11;
int maxInUse = 1;
int currentState1;
int currentState2;
MaxMatrix m(data, load, clock, maxInUse);
const int buzzer = 6;
const int button1 = 3;
const int button2 = 4;
const int ic = 261;
const int id = 294;
const int ie = 329;
const int iaf = 349;
const int ig = 391;
const int igS = 415;
const int ia = 440;
const int iaS = 455;
const int ib = 466;
const int icH = 523;
const int icSH = 554;
const int idH = 587;
const int idSH = 622;
const int ieH = 659;
const int ifH = 698;
const int ifSH = 740;
const int igH = 784;
const int igSH = 830;
const int iaH = 880;
char idlestring[] = " no clue what else to add!  ";  //idle text (leave 2 spaces after for text to fully clear before it repeats)
char string1[] = " Hello world! ";
char string2[] = " Now playing: ";
char string3[] = "Imperial March   ";
byte buffer[10];
void firstSection() {
  beep(ia, 500);
  beep(ia, 500);
  beep(ia, 500);
  beep(iaf, 350);
  beep(icH, 150);
  beep(ia, 500);
  beep(iaf, 350);
  beep(icH, 150);
  beep(ia, 650);
  delay(500);
  beep(ieH, 500);
  beep(ieH, 500);
  beep(ieH, 500);
  beep(ifH, 350);
  beep(icH, 150);
  beep(igS, 500);
  beep(iaf, 350);
  beep(icH, 150);
  beep(ia, 650);
  delay(500);
}

void secondSection() {
  beep(iaH, 500);
  beep(ia, 300);
  beep(ia, 150);
  beep(iaH, 500);
  beep(igSH, 325);
  beep(igH, 175);
  beep(ifSH, 125);
  beep(ifH, 125);
  beep(ifSH, 250);
  delay(325);
  beep(iaS, 250);
  beep(idSH, 500);
  beep(idH, 325);
  beep(icSH, 175);
  beep(icH, 125);
  beep(ib, 125);
  beep(icH, 250);
  delay(350);
}
void beep(int note, int duration) {
  tone(buzzer, note, duration);
  delay(duration);
  noTone(buzzer);
  delay(50);
}
void printCharWithShift(char c, int shift_speed) {
  if (c < 32) return;
  c -= 32;
  memcpy_P(buffer, CH + 7 * c, 7);
  m.writeSprite(maxInUse * 8, 0, buffer);
  m.setColumn(maxInUse * 8 + buffer[0], 0);
  for (int i = 0; i < buffer[0] + 1; i++) {
    delay(shift_speed);
    m.shiftLeft(false, false);
  }
}
void printStringWithShift(char* s, int shift_speed) {
  while (*s != 0) {
    printCharWithShift(*s, shift_speed);
    s++;
  }
}

void setup() {
  m.init();
  m.setIntensity(15);
  pinMode(buzzer, OUTPUT);
  pinMode(button1, INPUT);
  pinMode(button2, INPUT);
  Serial.begin(9600);
}

void buttonOne() {
  printStringWithShift(string2, 70);
  printStringWithShift(string3, 70);
  m.writeSprite(0, 0, skullEmoji);
  firstSection();
  secondSection();
  beep(iaf, 250);
  beep(igS, 500);
  beep(iaf, 350);
  beep(ia, 125);
  beep(icH, 500);
  beep(ia, 375);
  beep(icH, 125);
  beep(ieH, 650);
  delay(500);
  secondSection();
  beep(iaf, 250);
  beep(igS, 500);
  beep(iaf, 375);
  beep(icH, 125);
  beep(ia, 500);
  beep(iaf, 375);
  beep(icH, 125);
  beep(ia, 650);
  delay(650);
}


void buttonTwo() {
  printStringWithShift(string1, 70);

  beep(ia, 500);
}

void buttonBoth() {
  beep(ia, 1000);
}

void loop() {

  digitalWrite(button1, HIGH);
  digitalWrite(button2, HIGH);

  currentState1 = digitalRead(button1);
  currentState2 = digitalRead(button2);

  while (Serial.available() > 0) {
    byte c = Serial.read();
    Serial.println(c, DEC);
    printCharWithShift(c, 100);
  }

  m.shiftLeft(false, true);
  m.setIntensity(5);

  if (currentState1 == 0) {

    delay(50);

    if (currentState2 == 1) {
      buttonOne();

    } else {

      buttonBoth();
    }
  }

  if (currentState2 == 0) {

    delay(50);

    if (currentState1 == 1) {
      buttonTwo();
    } else {

      buttonBoth();
    }
  } else {
    printStringWithShift(idlestring, 70);
    delay(250);
  }

  delay(200);
}